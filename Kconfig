## Kconfig
```kconfig
DT_COMPAT_ZMK_BEHAVIOR_LAYER_MORPH := zmk,behavior-layer-morph

config ZMK_BEHAVIOR_LAYER_MORPH
 bool
 default $(dt_compat_enabled,$(DT_COMPAT_ZMK_BEHAVIOR_LAYER_MORPH))
```

## dts/bindings/zmk,behavior-layer-morph.yaml
```yaml
# Copyright (c) 2025 Rafael Romão
# SPDX-License-Identifier: MIT

description: |
    Layer Morph Behavior

    The layer morph behavior morphs a keypress based on whether a given layer is active.

compatible: "zmk,behavior-layer-morph"

include: zero_param.yaml

properties:
    bindings:
        type: phandle-array
        required: true
        description: |
            The bindings to use for the layer morph. The first binding is the normal
            binding, the second is the morphed binding.

    layers:
        type: array
        required: true
        description: |
            A layer or a list of layers to check for. If any of these layers is
            active, the morphed binding will be used.
```
